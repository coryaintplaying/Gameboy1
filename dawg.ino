//====================================================================
//=======================MENU=========================================
//====================================================================
// menu  128 x 64  
#include "U8glib.h"
#include <Wire.h>

U8GLIB_SSD1306_128X64 u8g(U8G_I2C_OPT_DEV_0 | U8G_I2C_OPT_NO_ACK | U8G_I2C_OPT_FAST);

//====================================================================
//=======================ICONS========================================
//====================================================================
// 'bird icon', 14x13px
const unsigned char bird_icon [] PROGMEM = {
	0x3e, 0x00, 0x41, 0x00, 0x91, 0x00, 0xc0, 0x80, 0x40, 0x40, 0x40, 0x40, 0x90, 0x20, 0x90, 0x20, 
	0x88, 0x10, 0x44, 0x08, 0x32, 0x7c, 0x0d, 0x80, 0x1b, 0x00
};
// 'car icon', 14x12px
const unsigned char car_icon [] PROGMEM = {
	0x03, 0xc0, 0x04, 0x20, 0x08, 0x10, 0x08, 0x10, 0x73, 0xf8, 0xa0, 0x04, 0xe0, 0x04, 0x80, 0x04, 
	0xb7, 0x68, 0x48, 0x90, 0x48, 0x90, 0x30, 0x60
};
// 'snake icon', 14x14px
const unsigned char snake_icon [] PROGMEM = {
	0x71, 0xc0, 0x8a, 0x30, 0xda, 0x18, 0x8b, 0x8c, 0x88, 0xc4, 0x88, 0x64, 0xcc, 0x24, 0x44, 0x24, 
	0x44, 0x24, 0x44, 0x64, 0x47, 0xc4, 0x40, 0x04, 0x40, 0x04, 0x7f, 0xf8
};

//====================================================================
//=======================SCROLL=======================================
//====================================================================
// 'scrollbar', 8x64px
const unsigned char scrollbar [] PROGMEM = {
  0xff, 0xff, 0xff, 0xff, 0x00, 0xff, 0xff, 0xff, 0xff, 0xff, 0xff, 0xff, 0x00, 0xff, 0xff, 0xff,
  0xff, 0xff, 0xff, 0xff, 0x00, 0xff, 0xff, 0xff, 0xff, 0xff, 0xff, 0xff, 0x00, 0xff, 0xff, 0xff,
  0xff, 0xff, 0xff, 0xff, 0x00, 0xff, 0xff, 0xff, 0xff, 0xff, 0xff, 0xff, 0x00, 0xff, 0xff, 0xff,
  0xff, 0xff, 0xff, 0xff, 0x00, 0xff, 0xff, 0xff, 0xff, 0xff, 0xff, 0xff, 0x00, 0xff, 0xff, 0xff
};


// 'scrolloutline', 120x21px
const unsigned char scrolloutline [] PROGMEM = {
	0x3f, 0xff, 0xff, 0xff, 0xff, 0xff, 0xff, 0xff, 0xff, 0xff, 0xff, 0xff, 0xff, 0xff, 0xe0, 0x40, 
	0x00, 0x00, 0x00, 0x00, 0x00, 0x00, 0x00, 0x00, 0x00, 0x00, 0x00, 0x00, 0x00, 0x10, 0x80, 0x00, 
	0x00, 0x00, 0x00, 0x00, 0x00, 0x00, 0x00, 0x00, 0x00, 0x00, 0x00, 0x00, 0x18, 0x80, 0x00, 0x00, 
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	0xff, 0xff, 0xff, 0xff, 0xff, 0xff, 0xff, 0xff, 0xff, 0xff, 0xe0
};

//====================================================================
//=======================MAIN=========================================
//====================================================================
const int number_items = 3; //number of items
int selected_item = 0; //which item is selected
int prev_selected_item; //previous item before the selected item
int next_selected_item; //next item after the selected item
int chosen_game = 99;
int up_clicked = 1;
int down_clicked = 1;
#define JOYSTICK_X A0 //horizontal
#define JOYSTICK_Y A1 //vertical
#define JOYSTICK_B A2 //button pin
#define ANALOG_X_CORRECTION 128 
#define ANALOG_Y_CORRECTION 128 
int currentMenuIndex = 0;



const unsigned char* bitmap_icons[3] = {
	bird_icon,
	car_icon,
	snake_icon,
};



char menu_items[number_items] [20] = {
	{"Bird"},
	{"Car"},
	{"Snake"}
};



// Define a structure to hold the icon configuration
struct Icon {
  const unsigned char* bitmap;
  uint8_t width;
  uint8_t height;
};



// Create an array mapping each icon to its custom dimensions
Icon menuIcons[] = {
  { bird_icon,  14, 13 }, // Index 0: Bird
  { car_icon,   14, 12 }, // Index 1: Car
  { snake_icon, 14, 14 }  // Index 2: Snake
};



void draw(int itemIndex1, uint8_t iconYcood, uint8_t textYcood) {
  u8g.drawStr(24, textYcood, menu_items[itemIndex1]);

  uint8_t byteWidth = (menuIcons[itemIndex1].width + 7) / 8;
  u8g.drawBitmapP(4, iconYcood, byteWidth, menuIcons[itemIndex1].height, 
  menuIcons[itemIndex1].bitmap);
}



void setup(){
  Serial.begin(9600);
  Wire.begin();
  u8g.setColorIndex(1); //(White)
  pinMode(JOYSTICK_B, INPUT_PULLUP);

  u8g.firstPage();
  do {
    u8g.setFont(u8g_font_courB14);
    u8g.drawStr(30, 37, "Gameb0y"); 
  } while (u8g.nextPage());
  delay(2000);
}



void loop(){

  prev_selected_item = selected_item - 1;
  if (prev_selected_item<0) {prev_selected_item=number_items-1;}
  next_selected_item = selected_item + 1;
  if (next_selected_item>=number_items) {next_selected_item=0;}

  int xVal = analogRead(JOYSTICK_X);
  int yVal = analogRead(JOYSTICK_Y);
  bool bVal = digitalRead(JOYSTICK_B); 

  if ((yVal > 850) && (down_clicked==1)) {  // Down
    selected_item-=1;
    if (selected_item<0) {selected_item = number_items-1;}
    down_clicked=0;
  } else if ((yVal < 150) && (up_clicked==1)) { // UP
    selected_item+=1;
    if (selected_item>=number_items) {selected_item=0;}
    up_clicked=0;
  } 
  
  if ((yVal < 850) && (down_clicked==0)) {down_clicked=1;} //reset Down
  if ((yVal > 150) && (up_clicked==0)) {up_clicked=1;} //reset UP 
  
  if (!bVal) {
    chosen_game=selected_item;
    Serial.print(bVal);
    Serial.println(menu_items[chosen_game]);
    delay(200);
  }

  u8g.firstPage();
  do {
    // previous item
    u8g.setFont(u8g_font_7x13);
    draw(prev_selected_item, 4, 16);

    //selected item
    u8g.setFont(u8g_font_7x13B);
    draw(selected_item, 26, 37);

    //next item    
    u8g.setFont(u8g_font_7x13);
    draw(next_selected_item, 47, 58);

		u8g.drawBitmapP(0, 22, 120/8, 21, scrolloutline);
    u8g.drawBitmapP(125, 0, 8/8, 64, scrollbar);
  
  } while (u8g.nextPage());

  delay(50);
}

//====================================================================
//=======================BUGS=========================================
//====================================================================
/*

1.Fix scroll bar  

*/
